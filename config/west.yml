## config/west.yml
```yaml
manifest:
  remotes:
    - name: zmkfirmware
      url-base: https://github.com/zmkfirmware
    - name: kaievns
      url-base: https://github.com/kaievns
  projects:
    - name: zmk
      remote: zmkfirmware
      revision: main
      import: app/west.yml
    - name: pmw3610-zmk-driver
      remote: kaievns
      url-base: https://github.com/kaievns
      revision: main
  self:
    path: config
```
